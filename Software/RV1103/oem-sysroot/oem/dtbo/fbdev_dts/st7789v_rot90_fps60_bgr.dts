/dts-v1/;
/plugin/;

/ {
    fragment@0 {
        target = <&spi0>;
        __overlay__ {
            status = "okay";
            fbtft@0 {
                status = "okay";
		reg = <0>;
                rotate = <90>;
                fps = <60>;
                bgr;
            };
        };
    };
};
